## Driver/Kconfig
```kconfig
menu "Gateway LORA"

config GATEWAY
	bool "LoRa gateway driver"
	depends on ARM64
	default y if ARM64
	help
	  Select this option to run gateway device!
endmenu
```

## sx1278/Kconfig
```kconfig
menu "sx1278 device driver"

config SX1278_LORA
	bool "sx1278 driver"
	help
		Select this option to run sx1278 device!
endmenu
```
